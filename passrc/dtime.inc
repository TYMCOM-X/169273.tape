(*---------------------------------------------------------------------------*)
(*
 *  INCLUDE FILE FOR PASCAL DAY/TIME ROUTINES PACKAGE.
 *)

EXTERNAL FUNCTION DAYTIME: DTIME_INT;
EXTERNAL FUNCTION DC_EXT(DTIME: DTIME_INT): DTIME_EXT;
EXTERNAL PROCEDURE EC_EXT(VAR ERR_CODE: DTIME_ERR;
   DT_EXT: NS_EXT; VAR TIME_: DTIME_INT);
EXTERNAL FUNCTION EXTR_DATE(DTIME: DTIME_INT): DATE_INT;
EXTERNAL FUNCTION EXTR_TIME(DTIME: DTIME_INT): TIME_INT;
EXTERNAL FUNCTION DT_COMBINE(DATE: DATE_INT; TIME: TIME_INT): DTIME_INT;
EXTERNAL FUNCTION DAYS_DIFF(DTIME1,DTIME2: DTIME_INT): DAYS;
EXTERNAL FUNCTION SECS_DIFF(DTIME1,DTIME2: DTIME_INT): SECONDS;
EXTERNAL FUNCTION ADD_DAYS(DTIME: DTIME_INT;
   NUM_DAYS: DAYS): DTIME_INT;
EXTERNAL FUNCTION ADD_SECS(DTIME: DTIME_INT;
   NUM_SECS: SECONDS): DTIME_INT;
EXTERNAL FUNCTION DAY_OF_WEEK(DATE: DATE_INT): WEEK_DAY;
EXTERNAL FUNCTION NS_D1(DATE: DATE_INT): NS_DATE1;
EXTERNAL FUNCTION NS_D2(DATE: DATE_INT): NS_DATE2;
EXTERNAL FUNCTION NS_T1(TIME: TIME_INT): NS_TIME1;
EXTERNAL FUNCTION GMDTIME: DTIME_INT;
EXTERNAL FUNCTION DC_DTIME(DTIME: DTIME_INT): DTIMEREC;
EXTERNAL PROCEDURE EC_DTIME(VAR ERR_CODE: DTIME_ERR; DTIMEBIN: DTIMEREC;
   VAR DTIME: DTIME_INT);
EXTERNAL PROCEDURE EC_DATE(VAR ERR_CODE: DTIME_ERR;
   DATE_BIN: DATEREC; VAR DATE: DATE_INT);
EXTERNAL FUNCTION DC_DATE(DATE: DATE_INT): DATEREC;
EXTERNAL PROCEDURE EC_TIME(VAR ERR_CODE: DTIME_ERR;
   TIME_BIN: TIMEREC; VAR TIME: TIME_INT);
EXTERNAL FUNCTION DC_TIME(TIME: TIME_INT): TIMEREC;
EXTERNAL FUNCTION EC_DCDATE(D_DATE: DEC_DATE): DATE_INT;
EXTERNAL FUNCTION EC_TSDATE(T_DATE: TYM_DATE): DATE_INT;
EXTERNAL FUNCTION EC_DCTIME(D_TIME: DEC_TIME): TIME_INT;
(*---------------------------------------------------------------------------*)
