(*VAXOPC.INC, last modified 1/4/84, zw*)
CONST
	addb2 = #H80;
	addb3 = #H81;
	addd2 = #H60;
	addd3 = #H61;
	addf2 = #H40;
	addf3 = #H41;
	addl2 = #Hc0;
	addl3 = #Hc1;
	addw2 = #Ha0;
	addw3 = #Ha1;
	aobleq = #Hf3;
	aoblss = #Hf2;
	ashl = #H78;
	ashq = #H79;
	bbc = #He1;
	bbcc = #He5;
	bbcci = #He7;
	bbcs = #He3;
	bbs = #He0;
	bbsc = #He4;
	bbss = #He2;
	bbssi = #He6;
	bcc = #H1e;
	bcs = #H1f;
	beql = #H13;
	beqlu = #H13;
	bgeq = #H18;
	bgequ = #H1e;
	bgtr = #H14;
	bgtru = #H1a;
	bicb2 = #H8a;
	bicb3 = #H8b;
	bicl2 = #Hca;
	bicl3 = #Hcb;
	bicpsw = #Hb9;
	bicw2 = #Haa;
	bicw3 = #Hab;
	bisb2 = #H88;
	bisb3 = #H89;
	bisl2 = #Hc8;
	bisl3 = #Hc9;
	bispsw = #Hb8;
	bisw2 = #Ha8;
	bisw3 = #Ha9;
	bitb = #H93;
	bitl = #Hd3;
	bitw = #Hb3;
	blbc = #He9;
	blbs = #He8;
	bleq = #H15;
	blequ = #H1b;
	blss = #H19;
	blssu = #H1f;
	bneq = #H12;
	bnequ = #H12;
	halt = #H00;	(* Used for error detection. *)
	bpt = #H03;
	brb = #H11;
	brw = #H31;
	bvc = #H1c;
	bvs = #H1d;
	calls = #Hfb;
	caseb = #H8f;
	casel = #Hcf;
	casew = #Haf;
	clrb = #H94;
	clrd = #H7c;
	clrf = #Hd4;
	clrl = #Hd4;
	clrq = #H7c;
	clrw = #Hb4;
	cmpv = #Hec;
	cmpvz = #Hed;
	cmpzv = #Hed;
	cmpb = #H91;
	cmpc3 = #H29;
	cmpc5 = #H2d;
	cmpd = #H71;
	cmpf = #H51;
	cmpl = #Hd1;
	cmpw = #Hb1;
	cvtbd = #H6c;
	cvtbf = #H4c;
	cvtbl = #H98;
	cvtbw = #H99;
	cvtdb = #H68;
	cvtdf = #H76;
	cvtdl = #H6a;
	cvtdw = #H69;
	cvtfb = #H48;
	cvtfd = #H56;
	cvtfl = #H4a;
	cvtfw = #H49;
	cvtlb = #Hf6;
	cvtld = #H6e;
	cvtlf = #H4e;
	cvtlw = #Hf7;
	cvtrdl = #H6b;
	cvtrfl = #H4b;
	cvtwb = #H33;
	cvtwd = #H6d;
	cvtwf = #H4d;
	cvtwl = #H32;
	decb = #H97;
	decl = #Hd7;
	decw = #Hb7;
	divb2 = #H86;
	divb3 = #H87;
	divd2 = #H66;
	divd3 = #H67;
	divf2 = #H46;
	divf3 = #H47;
	divl2 = #Hc6;
	divl3 = #Hc7;
	divw2 = #Ha6;
	divw3 = #Ha7;
	ediv = #H7b;
	emodd = #H74;
	extv = #Hee;
	extzv = #Hef;
	incb = #H96;
	incl = #Hd6;
	incw = #Hb6;
	index = #H0a;
	insv = #Hf0;
	jmp = #H17;
	jsb = #H16;
	locc = #H3a;
	matchc = #H39;
	mcomb = #H92;
	mcoml = #Hd2;
	mcomw = #Hb2;
	mnegb = #H8e;
	mnegd = #H72;
	mnegf = #H52;
	mnegl = #Hce;
	mnegw = #Hae;
	movab = #H9e;
	movad = #H7e;
	movaf = #Hde;
	moval = #Hde;
	movaq = #H7e;
	movaw = #H3e;
	movb = #H90;
	movc3 = #H28;
	movc5 = #H2c;
	movd = #H70;
	movf = #H50;
	movl = #Hd0;
	movq = #H7d;
	movtc = #H2e;
	movtuc = #H2f;
	movw = #Hb0;
	movzbl = #H9a;
	movzbw = #H9b;
	movzwl = #H3c;
	mulb2 = #H84;
	mulb3 = #H85;
	muld2 = #H64;
	muld3 = #H65;
	mulf2 = #H44;
	mulf3 = #H45;
	mull2 = #Hc4;
	mull3 = #Hc5;
	mulw2 = #Ha4;
	mulw3 = #Ha5;
	popr = #Hba;
	pushab = #H9f;
	pushad = #H7f;
	pushaf = #Hdf;
	pushal = #Hdf;
	pushaq = #H7f;
	pushaw = #H3f;
	pushl = #Hdd;
	pushr = #Hbb;
	ret = #H04;
	rotl = #H9c;
	scanc = #H2a;
	skpc = #H3b;
	sobgeq = #Hf4;
	sobgtr = #Hf5;
	spanc = #H2b;
	subb2 = #H82;
	subb3 = #H83;
	subd2 = #H62;
	subd3 = #H63;
	subf2 = #H42;
	subf3 = #H43;
	subl2 = #Hc2;
	subl3 = #Hc3;
	subw2 = #Ha2;
	subw3 = #Ha3;
	tstb = #H95;
	tstd = #H73;
	tstf = #H53;
	tstl = #Hd5;
	tstw = #Hb5;
	xorb2 = #H8c;
	xorb3 = #H8d;
	xorl2 = #Hcc;
	xorl3 = #Hcd;
	xorw2 = #Hac;
	xorw3 = #Had;
