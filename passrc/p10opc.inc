(* Opcode and runtime location definitions for PDP-10 *)

const	SP = 16B;
	SB = 17B;

const	ARG = 0B;
	CALLI = 47B;
	ADJSP = 105B;
	ADJ_SP = 5B;
	DFAD = 110B;
	DFSB = 111B;
	DFMP = 112B;
	DFDV = 113B;
	DMOVE = 120B;
	DMOVN = 121B;
	FIX = 122B;
	DMOVEM = 124B;
	DMOVNM = 125B;
	FIXR = 126B;
	FLTR = 127B;
	FSC = 132B;
	IBP = 133B;
	ADJBP = 133B;
	ADJ_BP = 4B;
	ILDB = 134B;
	LDB = 135B;
	IDPB = 136B;
	DPB = 137B;
	FADR = 144B;
	FADRM = 146B;
	FSBR = 154B;
	FSBRM = 156B;
	FMPR = 164B;
	FMPRM = 166B;
	FDVR = 174B;
	FDVRM = 176B;
	MOVE = 200B;
	MOVEI = 201B;
	MOVEM = 202B;
	MOVN = 210B;
	MOVNI = 211B;
	MOVNM = 212B;
	MOVM = 214B;
	MOVMM = 216B;
	IMUL = 220B;
	IMULI = 221B;
	IMULM = 222B;
	INTDIV = 230B;		(* mnemonic conflicts with lex symbol *)
	IDIVI = 231B;
	IDIVM = 232B;
	ASH = 240B;
	LSH = 242B;
	ASHC = 244B;
	LSHC = 246B;
	EXCH = 250B;
	BLT = 251B;
	AOBJN = 253B;
	JRST = 254B;
	JFCL = 255B;
	XCT = 256B;
	PUSHJ = 260B;
	PUSH = 261B;
	POP = 262B;
	POPJ = 263B;
	JSR = 264B;
	JSP = 265B;
	ADD = 270B;
	ADDI = 271B;
	ADDM = 272B;
	SUB = 274B;
	SUBI = 275B;
	SUBM = 276B;
	CAI = 300B;
	CAM = 310B;
	JUMP = 320B;
	SKIP = 330B;
	SKIPE = 332B;
	SKIPN = 336B;
	SETZ = 400B;
	SETZM = 402B;
	SETZB = 403B;
	ANDA = 404B;
	ANDI = 405B;
	ANDM = 406B;
	ANDCA = 410B;
	ANDCAI = 411B;
	ANDCAM = 412B;
	ANDCM = 420B;
	ANDCMI = 421B;
	XOR = 430B;
	XORI = 431B;
	IOR = 434B;
	IORI = 435B;
	IORM = 436B;
	ANDCB = 440B;
	ANDCBI = 441B;
	EQV = 444B;
	SETCA = 450B;
	ORCA = 454B;
	SETCM = 460B;
	ORCM = 464B;
	ORCMI = 465B;
	ORCB = 470B;
	SETO = 474B;
	SETOM = 476B;
	SETOB = 477B;
	HLL = 500B;
	HLLI = 501B;
	HLLM = 502B;
	HRL = 504B;
	HRLI = 505B;
	HRLM = 506B;
	HLLZ = 510B;
	HLLZI = 511B;
	HLLZS = 513B;
	HRLZ = 514B;
	HRLZI = 515B;
	HRLZM = 516B;
	HLLOI = 521B;
	HLLOS = 523B;
	HRLOI = 525B;
	HLLE = 530B;
	HLLEI = 531B;
	HLLEM = 532B;
	HRLEI = 535B;
	HRR = 540B;
	HRRI = 541B;
	HRRM = 542B;
	HLR = 544B;
	HLRI = 545B;
	HLRM = 546B;
	HRRZ = 550B;
	HRRZI = 551B;
	HRRZM = 552B;
	HRRZS = 553B;
	HLRZ = 554B;
	HLRZI = 555B;
	HRROI = 561B;
	HRROS = 563B;
	HLROI = 565B;
	HRRE = 570B;
	HRREI = 571B;
	HRREM = 572B;
	HRRES = 573B;
	HLRE = 574B;
	HLREI = 575B;
	TRNE = 602B;
	TLNE = 603B;
	TRNA = 604B;
	TRNN = 606B;
	TLNN = 607B;
	TDNE = 612B;
	TDNN = 616B;
	TLZ = 621B;
	TDZE = 632B;
	TDZA = 634B;
	TDZN = 636B;
	TLO = 661B;

const	IMDC = 1;		(* sub opcodes for move, arithmetic groups *)
	MEMC = 2;
	BOTHC = 3;
	SELFC = 3;

const	NVC = 0;		(* sub opcodes for CAI, CAM, JUMP, SKIP groups *)
	LTC = 1;
	EQC = 2;
	LEC = 3;
	AWC = 4;
	GEC = 5;
	NEC = 6;
	GTC = 7;
type  cmp_codes = NVC..GTC;
